/*@!Encoding:1252*/
includes
{
 
}

variables
{
 int port =3;
  char command_engine_run_voltage[256]="VOLT 13.6";
  char command_High_voltage[256]="VOLT 17.5";
  char command_low_voltage[256]="VOLT 7.6";
  char command_normal_voltage[256]="VOLT 12.5";
  char command_Powersupply_turnON[256]="OUTP 1";
  char command_Powersupply_turnOFF[256]="OUTP 0";
  char command_reset_Powersupply[256]="*RST";
  char command_OVP_Powersupply[256]="VOLT:OVER:PROT:STAT 1";
  char command_OVP_delay_time_itechPS[256] ="VOLT:OVER:PROT:DEL 00";
  char command_set_OVP_limit_itechPS[256]="VOLT:OVER:PROT 18.6";
}

on start
{
  long res;
  @sysvar::TEL_ITECH_PowerSupply::Control=1;
  @sysvar::TEL_ITECH_PowerSupply::voltage=0;
  if(1 == rs232Close(port))
    write("Port Closed Successfully");
  res = rs232Open(port);
  if(res==1)
    write("Port Opened Successfully");
   res = rs232Configure(port,9600,8,1,0);
  if(res==1)
    write("Port Configured successfully");
  
  send_command_ITECH_PS(command_Powersupply_turnON);
  send_command_ITECH_PS(command_normal_voltage);
  function_OVP_set_itechPS();
  
}



on sysvar TEL_ITECH_PowerSupply::Control
{
  if ((@this)==0) // Make the Power Supply as OFF
  {
	 send_command_ITECH_PS(command_Powersupply_turnOFF);
  }
  
  if ((@this)==1) // Make the Power Supply as ON
  {
    send_command_ITECH_PS(command_Powersupply_turnON);
  }
 }

on sysvar TEL_ITECH_PowerSupply::Normal_Voltage
{
  send_command_ITECH_PS(command_normal_voltage);
}

on sysvar TEL_ITECH_PowerSupply::Low_Voltage
{
  send_command_ITECH_PS(command_low_voltage);
}

on sysvar TEL_ITECH_PowerSupply::High_Voltage
{
  send_command_ITECH_PS(command_High_voltage);
}

on sysvar TEL_ITECH_PowerSupply::Engine_Run_Voltage
{
  send_command_ITECH_PS(command_engine_run_voltage);
  
} 

on sysvar TEL_ITECH_PowerSupply::reset_powersupply
{
  send_command_ITECH_PS(command_reset_Powersupply);   
    @sysvar::TEL_ITECH_PowerSupply::voltage=0;
    
  function_OVP_set_itechPS();
  send_command_ITECH_PS(command_Powersupply_turnON);

}

on sysvar TEL_ITECH_PowerSupply::voltage
{
  char voltagestr[20];
  // For BCM safety voltage should be limited to 18.5 in offshore. Testcases that requires Voltage>18.5 need to be executed in onsite bench.
  if(@this>18.5)
  {
    @this=18.5;
  }
  
  snprintf(voltagestr,elcount(voltagestr),"VOLT %0.2f",@this); // For concatanating: voltagestr = VOLT 12.36s
  write("Volts=%d",@this);
  send_command_ITECH_PS(voltagestr);
  
}

void function_OVP_set_itechPS()
{
  
   send_command_ITECH_PS(command_OVP_Powersupply);
   set_OVP_delay_time_itechPS();
   set_OVP_limit_itechPS(); 
}
void set_OVP_delay_time_itechPS()
{
  send_command_ITECH_PS(command_OVP_delay_time_itechPS);
   
}
void set_OVP_limit_itechPS()
{
  send_command_ITECH_PS(command_set_OVP_limit_itechPS);
    
}
void send_command_ITECH_PS(char Command_PS[])
{
  long res;   
	//char Command_PS[256] = "VOLT 13.6";
	byte buffer[256];
	int i;
	int length;
	 
	length=strlen(Command_PS);
	for (i=0;i<length;i++)
  {
	  buffer[i]=Command_PS[i];   
  }  
  buffer[i]=0x0A;
  
	res = RS232Send(port,buffer,(length+1)); //send data.
	if ( res==1)
	   write("Command Send Successfully"); 
  
}
on stopMeasurement
{
  @sysvar::TEL_ITECH_PowerSupply::voltage=0;
}